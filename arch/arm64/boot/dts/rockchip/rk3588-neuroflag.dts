// Fork from rk3588-firefly-aio-3588q-edp_NV156FHM-T06.dts

/dts-v1/;

#include "rk3588-firefly-aio-3588q.dtsi"
#include "rk3588-firefly-aio-cam-8ms1m.dtsi"
#include "rk3588-firefly-aio-cam-imx415.dtsi"
#include "rk3588-firefly-aio-cam-2ms2mf.dtsi"
#include "rk3588-firefly-demo.dtsi"
#include "rk3588-firefly-aio-3588q-edp_NV156FHM-T06.dtsi"

/ {
	model = "Neuroflag RK3588 (Linux)";
	compatible = "rockchip,rk3588-firefly-aio-3588q-edp-nv156fhm-t06", "rockchip,rk3588";
};
